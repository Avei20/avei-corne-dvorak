## config/west.yml
```yaml
manifest:
  remotes:
    - name: zmkfirmware
      url-base: https://github.com/zmkfirmware
    - name: urob
      url-base: https://github.com/urob
  projects:
    - name: zmk
      remote: zmkfirmware
      revision: v0.3        # ← this is what pins the actual ZMK source
      import: app/west.yml
    - name: zmk-helpers
      remote: urob
      revision: main        # zmk-helpers tracks main, generally fine
  self:
    path: config
```
